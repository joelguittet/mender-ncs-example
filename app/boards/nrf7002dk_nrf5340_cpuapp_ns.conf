## app/boards/nrf7002dk_nrf5340_cpuapp_ns.conf
```kconfig
# @file      nrf7002dk_nrf5340_cpuapp_ns.conf
# @brief     nRF7002-DK cpuapp non-secure project configuration file
#
# Copyright joelguittet and mender-mcu-client contributors
#
# Licensed under the Apache License, Version 2.0 (the "License");
# you may not use this file except in compliance with the License.
# You may obtain a copy of the License at
#
#     http://www.apache.org/licenses/LICENSE-2.0
#
# Unless required by applicable law or agreed to in writing, software
# distributed under the License is distributed on an "AS IS" BASIS,
# WITHOUT WARRANTIES OR CONDITIONS OF ANY KIND, either express or implied.
# See the License for the specific language governing permissions and
# limitations under the License.

# General
CONFIG_EXAMPLE_ARTIFACT_NAME_PREFIX="mender-nrf7002dk-ncs-example"
CONFIG_EXAMPLE_DEVICE_TYPE="mender-nrf7002dk-ncs-example"

# General
CONFIG_SYSTEM_WORKQUEUE_STACK_SIZE=4096
CONFIG_HEAP_MEM_POOL_SIZE=40144
CONFIG_NRF_WIFI_CTRL_HEAP_SIZE=20000
CONFIG_NRF_WIFI_DATA_HEAP_SIZE=59856
CONFIG_HEAP_MEM_POOL_IGNORE_MIN=y
CONFIG_HW_STACK_PROTECTION=y
CONFIG_ZVFS_OPEN_MAX=25
CONFIG_MAIN_STACK_SIZE=6144

# Optimize Wi-Fi stack to save some memory
CONFIG_NRF70_RX_NUM_BUFS=16
CONFIG_NRF70_MAX_TX_AGGREGATION=4

# Wi-Fi
CONFIG_WIFI=y
CONFIG_WIFI_NRF70=y
CONFIG_WIFI_CREDENTIALS=y
CONFIG_EXAMPLE_WIFI_SSID="<insert your ssid here>"
CONFIG_EXAMPLE_WIFI_PSK="<insert your password here>"
CONFIG_FLASH=y
CONFIG_FLASH_PAGE_LAYOUT=y
CONFIG_FLASH_MAP=y

# Shell
CONFIG_SHELL=y
CONFIG_SHELL_STACK_SIZE=6144
CONFIG_NET_L2_WIFI_SHELL=y

# WPA
CONFIG_WIFI_NM_WPA_SUPPLICANT=y

# NET sockets
CONFIG_NET_L2_ETHERNET=y
CONFIG_NET_UDP=y
CONFIG_NET_TCP=y
CONFIG_NET_SOCKETS_OFFLOAD=n
CONFIG_NET_DHCPV4=y
CONFIG_NET_CONTEXT_SNDTIMEO=y
CONFIG_NET_CONTEXT_RCVTIMEO=y
CONFIG_NET_RX_STACK_SIZE=2048

# mbedTLS
CONFIG_MBEDTLS_PSA_CRYPTO_EXTERNAL_RNG_ALLOW_NON_CSPRNG=n

# SPI (used to communicate with the mx25r64 external flash memory)
CONFIG_SPI=y
CONFIG_SPI_NOR=y
CONFIG_SPI_NOR_SFDP_DEVICETREE=y
CONFIG_PM_OVERRIDE_EXTERNAL_DRIVER_CHECK=y

# TLS credentials
# NOTE: this option permits to store the TLS credentials in the TF-M Protected Storage partition
# It is good but it is not required in this example as the ca certificate(s) is(are) added on boot
#CONFIG_TLS_CREDENTIALS_BACKEND_PROTECTED_STORAGE=y

# Optimize TF-M
CONFIG_TFM_PROFILE_TYPE_SMALL=y
CONFIG_PM_PARTITION_SIZE_TFM_SRAM=0xc000
CONFIG_PM_PARTITION_SIZE_TFM=0x1fe00

# Enable LTO to save flash memory
CONFIG_LTO=y
CONFIG_ISR_TABLES_LOCAL_DECLARATION=y
```

## app/testcase.yaml
```yaml
# @file      testcase.yaml
# @brief     twister test file used to execute tests on the targets
#
# Copyright joelguittet and mender-mcu-client contributors
#
# Licensed under the Apache License, Version 2.0 (the "License");
# you may not use this file except in compliance with the License.
# You may obtain a copy of the License at
#
#     http://www.apache.org/licenses/LICENSE-2.0
#
# Unless required by applicable law or agreed to in writing, software
# distributed under the License is distributed on an "AS IS" BASIS,
# WITHOUT WARRANTIES OR CONDITIONS OF ANY KIND, either express or implied.
# See the License for the specific language governing permissions and
# limitations under the License.

common:
  sysbuild: True
  timeout: 3600
  slow: true
  harness: pytest
  harness_config:
    pytest_dut_scope: function
    pytest_root:
      - "pytest/test_mender_mcu_client.py"
  tags:
    - testing
    - pytest
    - shell

tests:
  mender.mcu.client.default:
    extra_args: EXTRA_CONF_FILE="${WEST_TOPDIR}/local.conf;mcumgr.conf"
    platform_allow:
      - nrf7002dk/nrf5340/cpuapp/ns
  mender.mcu.client.troubleshoot:
    extra_args: EXTRA_CONF_FILE="${WEST_TOPDIR}/local.conf;mcumgr.conf;troubleshoot.conf"
    platform_allow:
      - nrf7002dk/nrf5340/cpuapp/ns
```

## sysbuild/mcuboot/boards/nrf7002dk_nrf5340_cpuapp.conf
```kconfig
# @file      nrf7002dk_nrf5340_cpuapp.conf
# @brief     nRF7002-DK cpuapp mcuboot configuration file
#
# Copyright joelguittet and mender-mcu-client contributors
#
# Licensed under the Apache License, Version 2.0 (the "License");
# you may not use this file except in compliance with the License.
# You may obtain a copy of the License at
#
#     http://www.apache.org/licenses/LICENSE-2.0
#
# Unless required by applicable law or agreed to in writing, software
# distributed under the License is distributed on an "AS IS" BASIS,
# WITHOUT WARRANTIES OR CONDITIONS OF ANY KIND, either express or implied.
# See the License for the specific language governing permissions and
# limitations under the License.

# MCUboot configurations to host the secondary image slot on the mx25r64 external flash memory.

# General
CONFIG_FLASH=y
CONFIG_MULTITHREADING=y
CONFIG_NRF_RTC_TIMER_USER_CHAN_COUNT=0

# Serial Peripheral Interface (SPI)
CONFIG_SPI=y
CONFIG_SPI_NOR=y
CONFIG_SPI_NOR_SFDP_DEVICETREE=y
CONFIG_SPI_NOR_FLASH_LAYOUT_PAGE_SIZE=4096

# MCUBoot and Partition Manager
CONFIG_PM_OVERRIDE_EXTERNAL_DRIVER_CHECK=y
CONFIG_PM_PARTITION_SIZE_MCUBOOT=0x10000
CONFIG_BOOT_MAX_IMG_SECTORS=256
CONFIG_BOOT_ERASE_PROGRESSIVELY=y
CONFIG_SOC_FLASH_NRF_EMULATE_ONE_BYTE_WRITE_ACCESS=y
```
