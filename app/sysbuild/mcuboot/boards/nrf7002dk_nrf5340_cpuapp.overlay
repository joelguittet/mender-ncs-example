/**
 * @file      nrf7002dk_nrf5340_cpuapp.overlay
 * @brief     nRF7002-DK cpuapp mcuboot overlay
 *
 * Copyright joelguittet and mender-mcu-client contributors
 *
 * Licensed under the Apache License, Version 2.0 (the "License");
 * you may not use this file except in compliance with the License.
 * You may obtain a copy of the License at
 *
 *     http://www.apache.org/licenses/LICENSE-2.0
 *
 * Unless required by applicable law or agreed to in writing, software
 * distributed under the License is distributed on an "AS IS" BASIS,
 * WITHOUT WARRANTIES OR CONDITIONS OF ANY KIND, either express or implied.
 * See the License for the specific language governing permissions and
 * limitations under the License.
 */

/ {
    /* Configure the partition manager to use the mx25r64 external flash memory */
    chosen {
        nordic,pm-ext-flash = &mx25r64;
    };
};

&mx25r64 {
    status = "okay";
};
